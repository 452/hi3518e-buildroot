## package/ffmpeg_fork/Config.in
```kconfig
comment "ffmpeg_fork needs a toolchain w/ largefile, IPv6"
	depends on !(BR2_LARGEFILE && BR2_INET_IPV6)
	depends on !BR2_TOOLCHAIN_EXTERNAL_CODESOURCERY_NIOSII201305
	depends on !BR2_TOOLCHAIN_EXTERNAL_CODESOURCERY_NIOSII201405

menuconfig BR2_PACKAGE_FFMPEG_FORK
	bool "ffmpeg_fork"
	depends on BR2_LARGEFILE
	depends on BR2_INET_IPV6
	# fenv.h lacks FE_INVALID, FE_OVERFLOW & FE_UNDERFLOW
	depends on !BR2_TOOLCHAIN_EXTERNAL_CODESOURCERY_NIOSII201305
	depends on !BR2_TOOLCHAIN_EXTERNAL_CODESOURCERY_NIOSII201405
	help
	  Modified fork of FFMpeg
```

## package/nopoll/Config.in
```kconfig
config BR2_PACKAGE_NOPOLL
	bool "nopoll"
	depends on BR2_USE_MMU # fork()
	select BR2_PACKAGE_ZLIB
	help
	  --== Nopoll: a websocket toolkit ==--
	  OpenSource WebSocket toolkit http://www.aspl.es/nopoll
```
